/* Generated by WT for S1 project board 
 * If these files should be chaned, then please make a sync with WT or MTK
*/
#include "S96116AA1.dts"

/* Add Samsung configuration over here */
/ {
	fragment@model {
		target-path = "/";
		__overlay__ {
			usb_notifier {
				compatible = "samsung,usb-notifier";
			};
		};
	};
};

/*End of this file, DO NOT ADD ANYTHING HERE*/
