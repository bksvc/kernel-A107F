## Kernel/drivers/staging/samsung/sec_notifier/Kconfig
```kconfig
#
# notifier
#

comment "NOTIFIER configs"

config VBUS_NOTIFIER
	bool "VBUS notifier support"
	default n
	help
	  If you say yes here you will get support for
	  the VBUS status change notification.

config CABLE_TYPE_NOTIFIER
	bool "CABLE TYPE notifier support"
	depends on USB_NOTIFIER
	default n
	help
	  If you say yes here you will get support for
	  the CABLE TYPE status change notification.
```
